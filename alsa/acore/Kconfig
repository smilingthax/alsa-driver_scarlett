## alsa/arm/Kconfig
```kconfig
menu "ALSA ARM devices"
	depends on SND!=n && ARM

config SND_PXA2XX_AC97
	tristate "AC97 driver for the Intel PXA2xx chip"
	depends on ARCH_PXA && SND
	select SND_PXA2XX_PCM
	select SND_AC97_CODEC
	help
	  Say Y or M if you want to support any AC97 codec attached to
	  the PXA2xx AC97 interface.

config SND_PXA2XX_PCM
	tristate
	select SND_PCM
	help
	  Generic PCM module for PXA2xx

config SND_S3C2410
	tristate "S3C24XX Sound core"
	depends on ARCH_S3C2410 && SND
	select I2C_SENSOR
	select SND_PCM
	help
	  Say Y here if you want to use the inbuilt audio controller
	  on the S3C2410 or S3C2440

endmenu
```

## alsa/drivers/Kconfig
```kconfig
# ALSA generic drivers

config SND_SERIALMIDI
	tristate "Generic driver for serial MIDI adapters"
	depends on SND
	select SND_RAWMIDI
	help
	  If you want to use MIDI adapters connected to a standard
	  serial port, say Y here and read
	  <file:Documentation/sound/alsa/serialmidi.txt>.

	  For multi-port devices, this driver supports port selection
	  with the Roland SoundCanvas protocol and for Midiator
	  MS-124T/W devices; many other devices are SoundCanvas
	  compatible.

	  To compile this driver as a module, choose M here: the module
	  will be called snd-serialmidi.
```

## alsa/i2c/Kconfig
```kconfig
menu "Codecs on the I2C bus"
	depends on SND && I2C

config SND_UDA1380
	tristate "Codec Philips UDA1380"
	depends on SND && I2C
	help
	  Support for codec Philips UDA1380 on the I2C bus.
	  Automatically selected by glue code.

endmenu
```

## alsa/isa/Kconfig
```kconfig
menu "ISA devices"
	depends on SND!=n && ISA

config SND_PC98_CS4232
	tristate "NEC PC9800 CS4232 driver"
	depends on SND && X86_PC9800
	select SND_OPL3_LIB
	select SND_MPU401_UART
	select SND_PCM
	help
	  Say Y to include support for the on-board sound chip (CS4232)
	  in NEC PC-9801/PC-8921 PCs.

	  To compile this driver as a module, choose M here: the module
	  will be called snd-pc98-cs4232.

config SND_MIRO
	tristate "Miro miroSOUND PCM1pro/PCM12/PCM20radio driver"
	depends on SND
	select SND_OPL4_LIB
	select SND_CS4231_LIB
	select SND_MPU401_UART
	select SND_PCM
	help
	  Say 'Y' or 'M' to include support for Miro miroSOUND PCM1 pro, 
	  miroSOUND PCM12 and miroSOUND PCM20 Radio soundcards.

	  To compile this driver as a module, choose M here: the module
	  will be called snd-miro.

config SND_MSND_PINNACLE
	tristate "Turtle Beach MultiSound Pinnacle/Fiji driver"
	depends on SND && X86
	select SND_RAWMIDI
	select SND_PCM
	help
	  Say Y to include support for Turtle Beach MultiSound Pinnacle/
	  Fiji soundcards.

	  To compile this driver as a module, choose M here: the module
	  will be called snd-msnd-pinnacle.

endmenu
```

## alsa/pci/Kconfig
```kconfig
menu "PCI devices"
	depends on SND!=n && PCI

config SND_PDPLUS
	tristate "Sek'D/Marian Prodif Plus"
	depends on SND
	select SND_PCM
	help
	  Say Y here to include support for Sek'D/Marian Prodif Plus
	  soundcards.

	  To compile this driver as a module, choose M here: the module
	  will be called snd-pdplus.

config SND_ASIHPI
	tristate "AudioScience ASIxxxx"
	depends on SND && X86
	select FW_LOADER
	select SND_PCM
	help
	  Say 'Y' or 'M' to include support for AudioScience ASIxxxx soundcards.

config SND_OXYGEN_LIB
	tristate
	depends on SND
	select SND_PCM
	select SND_MPU401_UART

config SND_VIRTUOSO
	tristate "Asus Virtuoso 200 (Xonar) support"
	depends on SND
	select SND_OXYGEN_LIB
	help
	  Say Y here to include support for sound cards based on the
	  Asus AV200 chip, i.e., Xonar D2 and Xonar D2X.

	  To compile this driver as a module, choose M here: the module
	  will be called snd-virtuoso.

config SND_OXYGEN
	tristate "C-Media 8788 (Oxygen) support"
	depends on SND
	select SND_OXYGEN_LIB
	help
	  Say Y here to include support for sound cards based on the
	  C-Media CMI8788 (Oxygen HD Audio) chip:
	   * Asound A-8788
	   * AuzenTech X-Meridian
	   * Bgears b-Enspirer
	   * Club3D Theatron DTS
	   * HT-Omega Claro
	   * Razer Barracuda AC-1
	   * Sondigo Inferno
	   * TempoTec HIFIER

	  To compile this driver as a module, choose M here: the module
	  will be called snd-oxygen.

endmenu
```

## alsa/sparc/Kconfig
```kconfig
menu "ALSA Sparc devices"
	depends on SND!=n && (SPARC32 || SPARC64)

config SND_SUN_DBRI
	tristate "Sun DBRI"
	depends on SND && SBUS
	select SND_PCM

endmenu
```

## alsa/usb/Kconfig
```kconfig
# ALSA USB drivers

menu "ALSA USB devices"
	depends on SND!=n && USB!=n

config SND_USB_USX2Y
	tristate "US-428 USB driver"
	depends on SND && USB
	select SND_PCM
	help
	  Say 'Y' or 'M' to include support for US-428 USB devices.

endmenu
```

## alsa/usb/us428/Kconfig
```kconfig
config SND_USB_US428
	tristate "Tascam USB US-428 driver"
	depends on SND && USB
	help
	  Say 'Y' or 'M' to include support for Tascam USB US-428.
```

## alsa/usb/usx2y/Kconfig
```kconfig
config SND_USB_USX2Y
	tristate "Tascam USB US-122 and US-428 driver"
	depends on SND && USB
	help
	  Say 'Y' or 'M' to include support for Tascam USB US-122 and US-428.
```
